## tests/controller/testcase.yaml
```yaml
tests:
  control.controller:
    platform_allow: native_posix
    integration_platforms:
      - native_posix
```

## tests/filter/testcase.yaml
```yaml
tests:
  control.filter:
    platform_allow: native_posix
    integration_platforms:
      - native_posix
```

## tests/linalg/testcase.yaml
```yaml
tests:
  control.linalg:
    platform_allow: native_posix
    integration_platforms:
      - native_posix
```

## tests/optimize/testcase.yaml
```yaml
# SPDX-License-Identifier: Apache-2.0
# Copyright (c) 2022 Martin Schröder <info@swedishembedded.com>
# Consulting: https://swedishembedded.com/go
# Training: https://swedishembedded.com/tag/training

tests:
  control.misc:
    platform_allow: native_posix
    integration_platforms:
      - native_posix
```

## west.yml
```yaml
# SPDX-License-Identifier: Apache-2.0
# Copyright (c) 2022 Martin Schröder <info@swedishembedded.com>

manifest:
  self:
    path: control

  remotes:
    - name: swedishembedded
      url-base: https://github.com/swedishembedded
  projects:
    - name: sdk
      remote: swedishembedded
      revision: main
```

## zephyr/Kconfig
```kconfig
# SPDX-License-Identifier: Apache-2.0
# Copyright (c) 2022 Martin Schröder <info@swedishembedded.com>
# Consulting: https://swedishembedded.com/consulting
# Training: https://swedishembedded.com/training

config CONTROL
	bool "Swedish Embedded control engineering library"
	default n
	depends on NEWLIB_LIBC || EXTERNAL_LIBC
	help
		Control engineering algorithm library
```
